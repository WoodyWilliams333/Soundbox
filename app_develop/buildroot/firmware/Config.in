## app_develop/buildroot/firmware/Config.in
```kconfig
menu "Firmware"

comment "Firmware"

config BR2_FIRMWARE
	bool "Build firmware"
	default y
	help
	  Enable this option if you want to build firmware for your embedded device

if BR2_FIRMWARE

config BR2_FIRMWARE_INSTALL_PATH
	string "firmware install path"
	default "$(BASE_DIR)/system/bin"

source ".config_wrapper/firmware_wrapper.in"

endif

endmenu
```

## app_develop/buildroot/host/Config.in
```kconfig
menu "System Tools"

comment "System Tools"

config BR2_PACKAGE_TOOLS
	bool "Build system tools"
	default y
	help
	  Enable this option if you want to build system tools for host(X86 system)

if BR2_PACKAGE_TOOLS

config BR2_TOOLS_SOURCE_PATH
	string
	default "$(WORKSPACE)/host"

config BR2_TOOLS_INSTALL_PATH
	string "system tools install path"
	default "$(WORKSPACE)/toolchain/tools"

source ".config_wrapper/tools_wrapper.in"

endif

endmenu
```

## app_develop/buildroot/library/Config.in
```kconfig
menu "Library"

comment "Library"

config BR2_PACKAGE_LIBRARY
	bool "Build library"
	default y
	help
	  Enable this option if you want to build a library your embedded device

if BR2_PACKAGE_LIBRARY

config BR2_LIBRARY_SOURCE_PATH
	string
	default "$(WORKSPACE)/library"

config BR2_LIBRARY_INSTALL_PATH
	string "library install path"
	default "$(BASE_DIR)/system/sdk/lib"

config BR2_BUILDCONFIG_CFG_SERIAL_BAUDRATE
	int "SCPD Serial baudrate"
	default 1625000

config BR2_BUILDCONFIG_CFG_NONBLOCK_SEARCH_CARD
	bool "Use nonblock mode to search card"
	default n

config BR2_BUILDCONFIG_CFG_CRYPTO_RSA_HW
	bool "Use rsa hardware crypto in wolfssl"
	default n

source ".config_wrapper/library_wrapper.in"

endif

endmenu
```

## app_develop/buildroot/platform/Config.in
```kconfig
menu "Product Options"

config BR2_PRODUCT_NAME
        string "Product Name"
        default "c2"

choice
	prompt "Build for Customer"
	default BR2_CUSTOMER_NORMAL
	
config BR2_CUSTOMER_NORMAL
	bool "normal"
	help
	  Build for developer.

config BR2_CUSTOMER_UPTS
	bool "upts"
	help
	  Build for UPTS

config BR2_CUSTOMER_AMP
	bool "amp"
	help
	  Build for amp

endchoice

config BR2_BUILDCONFIG_CFG_PCI_COMPLY
	bool
	default y
	depends on BR2_CUSTOMER_PCI || BR2_CUSTOMER_UPTS
	help
		Configuration for PCI

config BR2_BUILDCONFIG_CFG_UPTS_COMPLY
	bool
	default y
	depends on BR2_CUSTOMER_UPTS
	help 
		Configuration for UPTS

config BR2_BUILDCONFIG_CFG_VERIFY_DEVELOPMENT
	bool
	default y
	depends on BR2_FIRMWARE_TYPE_DEVELOP
	help
		Do not verify the signature of app in development version

config BR2_CUSTOMER_TYPE
	string 
	default "normal" if BR2_CUSTOMER_NORMAL
	default "amp"    if BR2_CUSTOMER_AMP
	default "upts"   if BR2_CUSTOMER_UPTS

choice
	prompt "firmware type"
	default BR2_FIRMWARE_TYPE_RELEASE
	help
	  Select firmware type, Release, Develop, PCI...

config BR2_FIRMWARE_TYPE_RELEASE
	bool "Release"
	help
	  Compile firmware with Signature/Authentication.
	  This version used for final release.
	  
config BR2_FIRMWARE_TYPE_PCI
	bool "PCI"
	help
	  Compile firmware with Signature/Authentication and with many secure policy.
	  This version used for PCI certification.
	  
config BR2_FIRMWARE_TYPE_DEVELOP
	bool "Develop"
	help
	  Compile firmware without Signature/Authentication.
	  This version used for development stage.
	
endchoice

config BR2_FIRMWARE_TYPE
	string
	default "dev"	if BR2_FIRMWARE_TYPE_DEVELOP
	default "rel"	if BR2_FIRMWARE_TYPE_RELEASE
	default "pci"	if BR2_FIRMWARE_TYPE_PCI

config BR2_FIRMWARE_SUFFIX
	string
	default "Develop"	if BR2_FIRMWARE_TYPE_DEVELOP
	default "Secure"	if BR2_FIRMWARE_TYPE_RELEASE
	default "Secure"	if BR2_FIRMWARE_TYPE_PCI
	
config BR2_PCI_COMPLY
	bool
	default y if BR2_FIRMWARE_TYPE_PCI
	default n if BR2_FIRMWARE_TYPE_RELEASE
	default n if BR2_FIRMWARE_TYPE_DEVELOP
	
config BR2_OUTPUT_PATH
	string
	default "$(BR2_PRODUCT_NAME)_$(BR2_CUSTOMER_TYPE)_$(BR2_FIRMWARE_TYPE)"

config BR2_IMAGE_NAME
	string "image name" 
	default "$(BR2_PRODUCT_NAME)$(BR2_CUSTOMER_TYPE).img"

config BR2_IMAGE_VERSION
	string "Image version"
	default "1.0.1"
	
config BR2_UPTS_VERSION
	string "UPTS version"
	default "010001"	

config BR2_MS_SIGNATURE_IP
	string "Signature IP for MS"
	default "10.1.23.2"
	
config BR2_MS_SIGNATURE_PORT
	string "Signature Port for MS"
	default "9210"

config BR2_MF_SIGNATURE_IP
	string "Signature IP for MF"
	default "10.1.23.2"

config BR2_MF_SIGNATURE_PORT
	string "Signature Port for MF"
	default "9210"	if BR2_CUSTOMER_NORMAL
	default "7000"	if BR2_CUSTOMER_AMP
	
config BR2_PREBUILT_PACKAGE_URL
        string "prebuilt package URL"
        default "http://10.1.40.23/build/c2"
        help
              prebuilt axf file URL.

endmenu
```

## app_develop/buildroot/secure/Config.in
```kconfig
menu "Secure Processor"
choice
	prompt "processor chooose"
	default BR2_MH190X_PROCESSOR
config BR2_MH190X_PROCESSOR
	bool "mh1902x"
	help
 	   choose mh1902x as secure processor
config BR2_CCORE_PROCESSOR
	bool "ccore"
	help
	  choose cuni360s as secure processor
endchoice

if BR2_CCORE_PROCESSOR
source "secure/ccore/Config.in"
endif

if BR2_MH190X_PROCESSOR
source "secure/mh1902/Config.in"
endif

endmenu
```

## app_develop/buildroot/secure/mh1902/Config.in
```kconfig
comment ""
comment "Toolchain for mh1902"

config BR2_SP_MH1902_TOOLCHAIN_URL
	string "Broadcom 5810 Toolchain"
	default "http://10.1.40.23/pub/toolchain/gcc/newlib-arm-unknown-bare-gnueabi-x86.tar.bz2"
	help
	  Enable this option if you want to build sp.

config BR2_SP_MH1902_TOOLCHAIN_INSTALL_PATH
        string "toolchain bcm5810 install PATH"
        default "$(WORKSPACE)/toolchain/newlib-arm-unknown-bare-gnueabi"
        help
            local path of the custom toolchain tarball to install.
	
config BR2_SP_MH1902_TOOLCHAIN_PREFIX
	string "MH1902 Toolchain prefix for cross compile"
	default "bin/arm-elf-"
	help
	  Enable this option if you want to build sp.

menu "misc option"
config BR2_SP_KERNEL_FLASH_OFFSET_ADDR
	hex  "kernel_offset_addr"
	default 0x01080000
	help
	  set kernel flash offset
config BR2_SP_CHIPFLASH_START_ADDR
	hex  "chipflash_start_addr"
	default 0x01001000
	help
	  set default chip start offset
config BR2_SP_FIRMWARE_VERSION
	string "sp firmare version"
	default "2.0.0"
config BR2_SP_BOOT_VERSION
	string "SP boot version"
	default "1.0.0" 

config BR2_SP_KERNEL_VERSION
	string "SP kernel version"
	default "1.0.0" 

config BR2_SP_KERNEL_IMG_NAME
	string "SP kernel img name"
	default "sp_mh_kernel.bin" 

config BR2_SP_BOOT_IMG_NAME
	string "SP kernel img name"
	default "sp_mh_boot.bin" 
endmenu
```

## app_develop/buildroot/toolchain/Config.in
```kconfig
menu "Toolchain"

config BR2_TOOLCHAIN_URL
	string "NDK Toolchain"
	default "http://10.1.40.23/pub/toolchain/ndk/ndk-toolchains-all.tar.bz2"
	help
	  Enable this option if you want to build sp.

config BR2_TOOLCHAIN_INSTALL_PATH
        string "NDK toolchain install PATH"
        default "$(WORKSPACE)/toolchain/"
        help
            local path of the custom toolchain tarball to install.
	
config BR2_TOOLCHAIN_PREFIX
	string "ARM9-ELF-EABI-THUMB Toolchain prefix for cross compile"
	default "ndk/toolchains/arm-unknown-eabi-4.9.4/prebuilt/linux-x86/bin/arm-unknown-eabi-"
	help
	  Enable this option if you want to build sp.

endmenu
```

## buildroot/prebuilt/Config.in
```kconfig
menu "prebuilt"

comment "prebuilt"

config BR2_BUILDCONFIG_CFG_VENDOR_IN_SP
	bool "vendor in sp(BR2_BUILDCONFIG_CFG_VENDER_IN_SP)"

config BR2_BUILDCONFIG_CONFIG_PIN_INPUT_KBD
	bool "input pin by keyboard(BR2_BUILDCONFIG_CONFIG_PIN_INPUT_KBD)"

config BR2_BUILDCONFIG_CONFIG_DUAL_CHIP_KBD	
	bool "keyboard control by two chip(BR2_BUILDCONFIG_CONFIG_DUAL_CHIP_KBD)"

config BR2_BUILDCONFIG_CONFIG_CCORE_UPDATE	
	bool "sp update for ccore(BR2_BUILDCONFIG_CONFIG_CCORE_UPDATE)"
	
config BR2_BUILDCONFIG_CONFIG_CCORE_SOTP_FLAG
	bool "CCORE factory formatting sets SOTP flag(BR2_BUILDCONFIG_CONFIG_CCORE_SOTP_FLAG)"
	
config BR2_BUILDCONFIG_CONFIG_DIGITAL_DISPLAY
	bool " digital tube display(BR2_BUILDCONFIG_CONFIG_DIGITAL_DISPLAY)"	
	
config BR2_BUILDCONFIG_CONFIG_TTS	
	bool "text to speech(BR2_BUILDCONFIG_CONFIG_TTS)"
	
source ".config_wrapper/prebuilt_wrapper.in"

endmenu
```

## buildroot/secure/ccore/Config.in
```kconfig
comment "Setting for ccore"

config BR2_SP_KERNEL_FLASH_OFFSET_ADDR
	hex  "kernel_offset_addr"
	default 0x01080000
	help
	  set kernel flash offset

config BR2_SP_CHIPFLASH_START_ADDR
	hex  "chipflash_start_addr"
	default 0x01001000
	help
	  set default chip start offset

config BR2_SP_FIRMWARE_VERSION
	string "sp firmare version"
	default "2.0.0"
	
config BR2_SP_BOOT_VERSION
	string "SP boot version"
	default "1.0.0" 

config BR2_SP_KERNEL_VERSION
	string "SP kernel version"
	default "1.0.0" 

config BR2_SP_KERNEL_IMG_NAME
	string "SP kernel img name"
	default "ccorek.bin" 

config BR2_SP_BOOT_IMG_NAME
	string "SP boot img name"
	default "ccoreb.bin" 
```

## buildroot/sysapp/Config.in
```kconfig
menu "System Application"

comment "System Application"

config BR2_PACKAGE_SYSAPP
	bool "Build system application"
	default y
	help
	  Enable this option if you want to build system application for your embedded device

if BR2_PACKAGE_SYSAPP

config BR2_SYSAPP_SOURCE_PATH
	string
	default "$(WORKSPACE)/sysapp"

config BR2_BUILDCONFIG_CONFIG_SP_BEEP
	bool "Beep the sp beeper"

config BR2_BUILDCONFIG_CONFIG_VENDOR_CRYPT
	bool "decrypt/encrypt by calling rpc_ped_vendor_dencrypt"

config BR2_BUILDCONFIG_CONFIG_DOWNLOAD_NOT_REBOOT
	bool "switch download not reboot"

config BR2_BUILDCONFIG_CONFIG_SELF_CHECK
	bool "Enable self check every 23 hours"

comment "Application List"

source ".config_wrapper/sysapp_wrapper.in"

endif

endmenu
```

## buildroot/usrapp/Config.in
```kconfig
menu "User Application"

comment "User Application"

config BR2_PACKAGE_USRAPP
	bool "Build user level application"
	default y
	help
	  Enable this option if you want to build user's application for your embedded device

if BR2_PACKAGE_USRAPP

config BR2_USRAPP_SOURCE_PATH
	string
	default "$(WORKSPACE)/usrapp"

source ".config_wrapper/usrapp_wrapper.in"

endif

endmenu
```

## buildroot/usrlib/Config.in
```kconfig
menu "User Library"

comment "User Library"

config BR2_PACKAGE_USER_LIBRARY
	bool "Build User library"
	default y
	help
	  Enable this option if you want to build a library your embedded device

if BR2_PACKAGE_USER_LIBRARY

config BR2_USER_LIBRARY_SOURCE_PATH
	string
	default "$(WORKSPACE)/usrlib"

config BR2_USER_LIBRARY_INSTALL_PATH
	string "user library install path"
	default "$(BASE_DIR)/sdk/usr/lib"

config BR2_BUILDCONFIG_CONFIG_USE_PED_RANDOM
	bool "Using ped random"
	default n
	help
		Get random from ped in SSL

source ".config_wrapper/usrlib_wrapper.in"

endif

endmenu
```
